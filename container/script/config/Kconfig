## container/script/config/Kconfig
```kconfig
mainmenu "CCAI configuration"

menu "CCAI service framework backend"

config OPENVINO
bool "OpenVINO"
default y

config PYTORCH
bool "PyTorch"
default y

config ONNX
bool "ONNX"
default y

config TENSORFLOW
bool "Tensorflow"
default n

endmenu

menu "Service"

menuconfig RESTFUL_SERVICE
bool "RESTful service"
default y
if RESTFUL_SERVICE

config RESTFUL_CAPABILITY
bool "capability"
default y

config RESTFUL_SAMPLE
bool "sample"
default y

endif

menuconfig GRPC_SERVICE
bool "gRPC service"
default y
if GRPC_SERVICE

config GRPC_SAMPLE
bool "sample"
default y


endif

endmenu
```

## container/script/config/defconfig
```kconfig
#
# CCAI service framework backend
#
CONFIG_OPENVINO=y
CONFIG_PYTORCH=y
CONFIG_ONNX=y
CONFIG_TENSORFLOW=y
CONFIG_PADDLE=y
# end of CCAI service framework backend

#
# Service
#
CONFIG_RESTFUL_SERVICE=y
CONFIG_RESTFUL_CAPABILITY=y
CONFIG_RESTFUL_SAMPLE=y
CONFIG_GRPC_SERVICE=y
CONFIG_GRPC_SAMPLE=y
# end of Service
```
